## conf/distro/helios9-distro.conf
```bitbake
# helios9 distribution configuration

DISTRO = "helios9-distro"
DISTRO_NAME = "helios9-distro"
DISTRO_VERSION = "0.1"
DISTRO_CODENAME = "scarthgap"

# SDK naming
SDK_VENDOR = "-helios9_distro_sdk"
SDK_VERSION = "${DISTRO_VERSION}"
SDK_NAME = "${DISTRO}-${TCLIBC}-${SDKMACHINE}-${IMAGE_BASENAME}-${TUNE_PKGARCH}-${MACHINE}"

# Use systemd
DISTRO_FEATURES = "acl ext2 ipv4 usbhost xattr systemd systemd-resolved usrmerge vfat"
DISTRO_FEATURES_BACKFILL_CONSIDERED = "sysvinit"
INIT_MANAGER = "systemd"

# Use IPK packages (fastest)
PACKAGE_CLASSES = "package_ipk"

# Version information
DISTRO_EXTRA_RDEPENDS:append = " os-release"

# Disable syslog
VIRTUAL-RUNTIME_syslog = ""
VIRTUAL-RUNTIME_base-utils-syslog = ""

SYMLINK_RESOLV_CONF = "1"

CMDLINE:append = " systemd.repart=yes"

ROOT_PART_TYPE = "${@bb.utils.contains('TUNE_FEATURES', 'aarch64', '8305', '8304', d)}"
WICVARS:append = " ROOT_PART_TYPE"
```

## conf/layer.conf
```bitbake
BBPATH .= ":${LAYERDIR}"

BBFILES += "${LAYERDIR}/recipes-*/*/*.bb ${LAYERDIR}/recipes-*/*/*.bbappend"

BBFILE_COLLECTIONS += "helios9"
BBFILE_PATTERN_helios9 = "^${LAYERDIR}/"
BBFILE_PRIORITY_helios9 = "10"
LAYERSERIES_COMPAT_helios9 = "scarthgap"

LAYERVERSION_helios9 = "1"

LAYERDEPENDS_helios9 = "core"
```

## wic/qemuarm-custom.wks
```
bootloader --ptable gpt
part / --source rootfs --ondisk vda --fstype ext4 --label rootfs1 --align 4096 --fixed-size 1G
part rootfs2           --ondisk vda --fstype ext4 --label rootfs2 --align 4096 --fixed-size 1G
part /data             --ondisk vda --fstype ext4 --label data    --align 4096 --fixed-size 2G
part /info             --ondisk vda --fstype ext4 --label info    --align 4096 --fixed-size 512M
```

## wic/sdimage-raspberrypi.wks
```
bootloader --ptable gpt-hybrid
part /boot --source bootimg-partition --ondisk mmcblk0 --fstype=vfat --label boot --active --align 4096 --size 100 --mbr
part / --source rootfs --ondisk mmcblk0 --fstype=ext4 --label root --align 4096 --size 512M --part-type ${ROOT_PART_TYPE}
```
